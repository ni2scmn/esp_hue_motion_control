## components/hue_api/Kconfig
```kconfig
menu "Hue API Configuration"
  config HUE_BRIDGE_IP
    string "Hue Bridge IP"
    help
      Enter the IP address of the Hue Bridge you want to connect to.
  
  config HUE_BRIDGE_USERNAME
    string "Hue Bridge Username"
    help
      Enter the username of the Hue Bridge you want to connect to.

endmenu
```

## components/motion_sensor/Kconfig
```kconfig
menu "PIR Motion Sensor Configuration"
  config PIR_SENSOR_PIN
    int "PIR Sensor Pin"
    help
      Enter the GPIO pin of the PIR motion sensor.
endmenu
```

## components/ssd1306_driver/Kconfig
```kconfig
menu "SSD1306 Configuration"
  config SSD1306_SDA_PIN
    int "SSD1306 SDA Pin"
    help
      Enter the SDA GPIO pin of the SSD1306 display.
  
  config SSD1306_SCL_PIN
    int "SSD1306 SCL Pin"
    help
      Enter the SCL GPIO pin of the SSD1306 display.

endmenu
```

## components/wifi_connector/Kconfig
```kconfig
menu "WiFi Connection Configuration"
  config WIFI_WOKWI_SIMULATOR
    bool "Wokwi Simulator"
    default false
    help
      Enable this option if you are using the Wokwi Simulator.

  config WIFI_CONNECTOR_SSID
    string "WiFi SSID"
    help
      Enter the SSID of the WiFi network you want to connect to.
  
  config WIFI_CONNECTOR_PASSWORD
    string "WiFi Password"
    help
      Enter the password of the WiFi network you want to connect to.
  
  config WIFI_CONNECTOR_HOSTNAME
    string "Hostname"
    default "esp32"
    help
      Enter the hostname of the device.

endmenu
```
